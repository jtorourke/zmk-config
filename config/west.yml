## config/west.yml
```yaml
manifest:
  remotes:
    - name: zmk
      url-base: https://github.com/AeternusCo
  projects:
    - name: zmk
      remote: zmkfirmware
      revision: main
      import: app/west.yml
  self:
    path: config
```
